/*
 * telemetry_task.c —— 温湿度遥测采集任务
 *
 * 它做四件事，按重要性排序：
 *   1. 周期性地读一次 DHT11；
 *   2. 成功就把读数格式化成一行 JSON 打出来（下一轮会同时 publish 到 MQTT）；
 *   3. 失败就记账、告警，但**继续跑**——一路环境数据读不到，
 *      不该影响 LED、按键这些本地功能；
 *   4. 定期上报栈水位，因为本任务是整个 app 里最吃栈的那个。
 *
 * 三个值得单独说的设计决定：
 *
 *   A. 用 vTaskDelay，而不是像 blink_task 那样"用队列的超时当延时"。
 *      那个手法的前提是**有事件源**（blink 要能被按键改周期）。
 *      本任务没有任何事件源，套用那种写法等于凭空造一个永远没人写的
 *      队列，只为了让两个文件长得像——那是形式主义。详见循环末尾的注释。
 *
 *   B. 保留"最后一次有效读数"，但**绝不把它当新数据报出去**。
 *      传感器偶尔读失败是常态（单总线对时序极敏感）。这里的选择是：
 *      失败就明说失败，同时明确标注"这是上次的值"，
 *      既不报一个假的 0℃/0%，也不让接收端把旧值误认成新采样。
 *
 *   C. 失败只记 ESP_LOGW，不记 ESP_LOGE。
 *      DHT11 是"辅助功能"：它挂了，本地功能照样跑。这与 button_task.c
 *      里"NVS 保存失败只记 warning"是同一个判断标准。
 *
 * 注意：任务的**名称 / 栈大小 / 优先级不在这里**——它们统一放在 app.c。
 * 一个任务"占多少资源"和"干什么活"分开放，调整时不用翻遍所有文件。
 * （rgb_task.c 里有同样的说明，保持一致。）
 */
#include "app_internal.h"
#include "telemetry_json.h"

#include "freertos/task.h"

#include "esp_err.h"
#include "esp_log.h"

#include "dht11.h"
#include "wifi_mgr.h"

static const char *TAG = "telemetry";

/*
 * 采样周期的下限（毫秒），只在上下文里的值异常时兜底。
 *
 * 为什么是 2000：
 *   DHT11 数据手册写明采样周期应大于 2 秒（另一份手册给的最小值
 *   是 1.7 秒、典型 2 秒），并且更严格地说"不建议反复读取，
 *   间隔大于 5 秒才能获得准确的温湿度"。
 *
 *   关键不在于"慢一点更省事"，而在于**读太快不会报错**：
 *   传感器会返回上一次的数据或垃圾值，而不是返回错误码。
 *   这种"看起来正常、实际是旧值"的问题最难排查。
 *
 *   这个值只做兜底，正常周期由 app.c 通过上下文的
 *   sample_interval_ms 提供（Kconfig 的范围也卡在 2000 起）。
 */
#define SAMPLE_INTERVAL_MIN_MS 2000

/* 每多少轮上报一次栈水位。采样周期默认 2000ms，约 10 秒报一次。 */
#define STACK_REPORT_EVERY_CYCLES 5

/*
 * 连续失败多少次之后，额外给一条"去看看硬件"的提示。
 * 取 5：按 2 秒一轮算，约 10 秒还没读通，基本可以排除偶发干扰了；
 * 再早容易误报，再晚用户已经等得不耐烦。
 */
#define FAIL_STREAK_HINT 5

void app_telemetry_task(void *arg)
{
    /* pvParameters 传进来的是 &s_ctx，在这里取回自己的上下文 */
    const app_ctx_t *ctx = (const app_ctx_t *)arg;

    /*
     * 采样周期。0 是灾难性的，必须先挡掉再进循环：
     *
     *   pdMS_TO_TICKS(0) == 0，vTaskDelay(0) 等于"立刻让出一次 CPU"
     *   马上又回来。于是本任务退化成不带任何延时的死循环：
     *   一边以 CPU 全速去锤 DHT11 的单总线（每次都撞驱动的
     *   min_interval 守卫），一边以同样的速度刷日志。
     *   同优先级下它还有 vTaskDelay 能让出 CPU，但控制台会被刷爆，
     *   真正有用的日志全被冲走，看门狗也更容易被日志本身拖出问题。
     *
     *   所以这里做一次防御性兜底并明确告警——静默改小一个配置项
     *   比报错更糟，用户会以为"我配的就是这个值"。
     */
    uint32_t interval_ms = ctx->sample_interval_ms;
    if (interval_ms == 0) {
        ESP_LOGW(TAG, "采样周期为 0 非法（会变成无延时的死循环），改用下限 %d ms",
                 SAMPLE_INTERVAL_MIN_MS);
        interval_ms = SAMPLE_INTERVAL_MIN_MS;
    }

    ESP_LOGI(TAG, "遥测任务启动，采样周期 %u ms", (unsigned)interval_ms);

    /*
     * "最后一次有效读数"的缓存。
     *
     * 为什么放在**局部变量**而不是 static？
     *   这份记忆天然属于"这个任务"：它是任务的私有状态，不需要被别的
     *   代码看到，也不需要跨任务共享。放栈上（局部变量）语义最准确，
     *   同时避免了"哪天这里被改成两个实例，static 就串味了"的隐患。
     *   函数是 while(1) 死循环，不会返回，所以局部变量的生命周期
     *   和任务一样长，不存在失效问题。
     */
    dht11_reading_t last_good     = { 0 };
    bool            has_last_good = false;
    uint32_t        fail_streak   = 0;
    uint32_t        cycles        = 0;

    while (1) {
        dht11_reading_t r;
        const esp_err_t ret = dht11_read(&r);

        if (ret == ESP_OK) {
            /* 读通了就把欠账清零，并刷新"最后一次有效读数" */
            fail_streak   = 0;
            last_good     = r;
            has_last_good = true;

            /*
             * 缓冲给 96 字节：报文最长约 47 字节（含 -40℃、100%、false
             * 这种极端组合），余量留足，免得将来加一个字段就要回头改这里。
             */
            char json[96];
            const int n = app_format_reading_json(json, sizeof(json), &r,
                                                  wifi_mgr_is_connected());
            if (n > 0) {
                /*
                 * ★ 格式串必须是字面量 "%s"，JSON 从**可变参数**传进去。
                 *
                 *   绝对不要写成 ESP_LOGI(TAG, json)：那是把报文当成了
                 *   格式串。报文里一旦出现 '%'（哪怕是将来某个文本字段
                 *   里的百分号），printf 就会去可变参数列表里找并不存在
                 *   的参数，轻则打印乱码，重则读越界、直接崩栈。
                 *
                 *   一句话：**报文是数据，不是格式**。
                 */
                ESP_LOGI(TAG, "%s", json);
            }
            /* n <= 0 时什么都不打：格式化函数内部已经说明原因了 */
        } else if (ret == ESP_ERR_INVALID_STATE) {
            /*
             * 这个错误码有两个来源：
             *
             *   1. 驱动尚未初始化——那是 app.c 的编排问题，第一次运行
             *      就会暴露，不该由本任务每轮重复报告；
             *   2. 距上次读取还没到 min_interval_ms——这是**完全正常**的，
             *      是驱动在替我们守时序，不是故障。
             *
             * 两种都不在这里打日志：尤其第 2 种，每轮都可能发生，
             * 一旦打日志就会把控制台刷屏，真正的故障反而被淹掉。
             * 安静跳过，交给循环末尾的延时即可。
             */
        } else {
            /*
             * 其余都是真失败：超时（器件没应答）、校验错、
             * 时序非法（脉宽不对 / 双解码不一致 / 数值越界）。
             */
            fail_streak++;

            /*
             * 用 ESP_LOGW 而不是 ESP_LOGE。理由与 button_task.c 里
             * "NVS 保存失败只记 warning"完全一致：
             *
             *   DHT11 是**辅助功能**。它读不到，LED 仍在闪、按键仍能
             *   切周期、RGB 仍在走彩虹——本地功能一个都没坏。
             *   为一个辅助功能的失败打上 ERROR 级别的措辞，
             *   会让日志里"ERROR"这个词贬值，真正致命的错误被埋掉。
             *   所以：功能失败 → ERROR；辅助功能失败 → WARNING + 继续跑。
             *
             * 另外，这里**不缓存值冒充新读数**：
             *   报 0/0 会让人以为"传感器真的读到 0℃"，其实压根没读到；
             *   把上次的旧值原样打出来，也会被当成这一轮的新采样。
             *   所以日志里明确写"本次无新数据、仅保留上次有效值"，
             *   与成功那行（纯 JSON，机器可解析）在形式上就分得开。
             */
            if (has_last_good) {
                ESP_LOGW(TAG,
                         "读取失败（%s），连续 %u 次；本次无新数据，"
                         "仅保留上次有效值 %d ℃/%d %%",
                         esp_err_to_name(ret), (unsigned)fail_streak,
                         last_good.temperature, last_good.humidity);
            } else {
                ESP_LOGW(TAG, "读取失败（%s），连续 %u 次；尚无任何有效读数",
                         esp_err_to_name(ret), (unsigned)fail_streak);
            }

            /*
             * 连续失败到阈值时，额外给一条指向**硬件**的提示。
             *
             * 为什么用 == 而不是 >= 或 % ？
             *   用 == 表示"只在刚好跨过第 5 次时提示一次"，之后不再重复。
             *   失败持续下去时，上面那条 WARN 已经在如实报数了，
             *   这里再每轮刷一遍"检查接线"只会淹没日志。
             *
             * 为什么先怀疑上拉电阻：
             *   DHT11 的数据线是**开漏**的，靠外部上拉把电平拉高。
             *   市售的"三针模块"自带这颗电阻，而裸传感器（四针）必须
             *   自己接一颗 4.7kΩ~5.1kΩ。漏接的典型症状就是"偶尔能读通、
             *   大部分时候超时"——正好对应这里的失败计数。
             *   其次才是接线松动、线太长（>20cm 时上升沿变缓，也会读不出来）。
             */
            if (fail_streak == FAIL_STREAK_HINT) {
                ESP_LOGW(TAG,
                         "连续 %u 次读不到 DHT11：请检查 DATA 线是否接好，"
                         "以及是否漏了 4.7kΩ~5.1kΩ 上拉电阻"
                         "（开漏总线没有上拉就出不了上升沿）",
                         (unsigned)fail_streak);
            }
        }

        /*
         * 栈水位上报。
         *
         * 本任务尤其值得盯这个值：它每轮都要走一遍
         * app_format_reading_json() 的 snprintf + ESP_LOGI 的格式化路径，
         * 而格式化是**整个 app 里最吃栈的操作**（snprintf 内部要用
         * 上百字节的转换缓冲，日志后端还会再格式化一次，中断也可能
         * 在此期间嵌套）。别的任务只是翻转 GPIO 或读一次队列，
         * 栈深度的量级完全不同。
         * 所以按轮数定期上报，用来判断 app.c 里给本任务的栈够不够——
         * 调栈大小要靠这个数，不能靠猜。
         */
        if (++cycles % STACK_REPORT_EVERY_CYCLES == 0) {
            app_report_stack(TAG);
        }

        /*
         * 为什么这里是 vTaskDelay，而 blink_task 用的是
         * "xQueueReceive 的超时参数当延时"？
         *
         *   那个手法的关键前提是**存在一个事件源**：blink 的周期会被
         *   按键改，所以它必须能在任意时刻被叫醒，"定时"和"响应事件"
         *   才能合并成一次带超时的阻塞调用。
         *
         *   本任务没有事件源——没有任何东西会在中途叫它，周期也不是
         *   运行期可变的。硬套队列写法就得凭空造一条永远没人写的队列：
         *   多一份内存、多一处可能出错的地方，还得再写一段注释解释
         *   "这条队列到底是干嘛的"。那不是清晰，那是为了和隔壁长得像。
         *
         *   所以这里用最朴素的 vTaskDelay，**如实**表达"我就是定时睡一觉"。
         *   判断顺序应该是：先问有没有事件源，再选等待方式；
         *   而不是先看别的任务怎么写。
         *
         * 顺带说一下时序上的"双保险"：
         *   DHT11 两次读取之间需要**多秒**的间隔（手册要求大于 2 秒，
         *   想要最准的数据则间隔 5 秒以上）。这里有两道防线：
         *     1) 本任务的 interval_ms（正常 2000ms）；
         *     2) 驱动内部的 min_interval_ms（来自 dht11_config_t）。
         *   两道都留着不是冗余而是分工：任务侧的延时保证不会无谓地
         *   空转敲门；驱动侧的守卫保证**别的调用方**（比如以后 MQTT
         *   那条路径直接读传感器）乱调时也不会破坏器件时序。
         *   守卫拦截时返回 ESP_ERR_INVALID_STATE，上面的分支已按
         *   "正常情况"静默处理，不会刷日志。
         */
        vTaskDelay(pdMS_TO_TICKS(interval_ms));
    }
}
